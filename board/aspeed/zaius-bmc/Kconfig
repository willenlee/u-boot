## board/aspeed/zaius-bmc/Kconfig
```kconfig
if TARGET_ZAIUS_BMC

config SYS_CPU
	default "arm1176"

config SYS_BOARD
	default "zaius-bmc"

config SYS_VENDOR
	default "aspeed"

config SYS_SOC
	default "aspeed"

config SYS_CONFIG_NAME
	default "zaius-bmc"

endif
```

## configs/ast_g4_phy_defconfig
```kconfig
CONFIG_ARM=y
CONFIG_TARGET_AST_G4=y
CONFIG_ASPEED_NET_PHY=y
CONFIG_SYS_PROMPT="ast# "
CONFIG_CMD_BOOTEFI=n
CONFIG_CMD_DHCP=y
CONFIG_CMD_PING=y
CONFIG_EFI_LOADER=n
CONFIG_FIT=y
CONFIG_FIT_VERBOSE=y
CONFIG_HUSH_PARSER=y
CONFIG_OF_LIBFDT=y
CONFIG_SPI_FLASH=y
CONFIG_SYS_NS16550=y
```

## configs/zaius_bmc_defconfig
```kconfig
CONFIG_ARM=y
CONFIG_DEFAULT_DEVICE_TREE="aspeed-zaius"
CONFIG_TARGET_AST_G5=y
CONFIG_SYS_PROMPT="ast# "
CONFIG_CMD_BOOTEFI=n
CONFIG_CMD_DHCP=y
CONFIG_CMD_PING=y
CONFIG_EFI_LOADER=n
CONFIG_FIT=y
CONFIG_FIT_VERBOSE=y
CONFIG_HUSH_PARSER=y
CONFIG_OF_LIBFDT=y
CONFIG_SPI_FLASH=y
CONFIG_SYS_NS16550=y
CONFIG_CMD_SAVEENV=y
CONFIG_CMD_FLASH=y
CONFIG_CMD_NET=y
CONFIG_CMD_PING=y
CONFIG_CMD_DHCP=y
CONFIG_DM=y
CONFIG_DM_I2C=y
CONFIG_CMD_I2C=y
CONFIG_OF_CONTROL=y
CONFIG_SYS_I2C_AST=y
CONFIG_ASPEED_ZAIUS=y
```
